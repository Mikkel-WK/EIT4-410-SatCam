/*
 * CAUTION: This file is automatically generated by Xilinx.
 * Version: XSCT 2021.2
 * Today is: Sun Mar  6 03:19:21 2022
 */


/dts-v1/;
#include "zynq-7000.dtsi"
#include "pl.dtsi"
#include "pcw.dtsi"
/ {
	chosen {
		bootargs = "earlycon";
		stdout-path = "serial0:115200n8";
	};
	aliases {
		i2c0 = &i2c0;
		i2c1 = &i2c1;
		serial0 = &uart1;
		spi0 = &qspi;
		/* Test
		video_in_axi_vdma_0 = &video_in_axi_vdma_0;
		video_out_axi_vdma_0 = &video_out_axi_vdma_0;
		video_out_v_tc_0 = &video_out_v_tc_0;
		audio_axi_i2s_adi_0 = &audio_axi_i2s_adi_0;
		*/
	};
	memory {
		device_type = "memory";
		reg = <0x0 0x8000000>;
	};
};
